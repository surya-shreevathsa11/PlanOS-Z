## Kconfig
```kconfig
# PlanOS-Z runtime options

menuconfig PLANOSZ
	bool "PlanOS-Z job-pack runtime"
	help
	  Contract-driven job-pack runtime: skill registry, admission control,
	  executor and NDJSON tracing.

if PLANOSZ

choice PLANOSZ_BACKEND
	prompt "PlanOS-Z hardware backend"
	default PLANOSZ_BACKEND_ESP32 if SOC_FAMILY_ESPRESSIF_ESP32
	default PLANOSZ_BACKEND_NATIVE_SIM

config PLANOSZ_BACKEND_NATIVE_SIM
	bool "native_sim (simulated sensors, no hardware)"

config PLANOSZ_BACKEND_ESP32
	bool "ESP32 (GPIO outputs via devicetree, sensors simulated until wired)"
	depends on SOC_FAMILY_ESPRESSIF_ESP32
	select GPIO

endchoice

config PLANOSZ_EXECUTOR_PARALLEL
	bool "Parallel DAG executor (worker threads)"
	default y
	help
	  Run independent plan steps concurrently on worker threads. Admission then uses the
	  matching WCET bound (critical path / list-scheduling bound). When disabled the
	  executor has a single worker and admission uses the sum of step WCETs.

config PLANOSZ_EXEC_WORKERS
	int "Executor worker threads"
	depends on PLANOSZ_EXECUTOR_PARALLEL
	range 2 8
	default 2
	help
	  Maximum number of steps in flight. Admission's WCET bound is computed for exactly
	  this many workers.

config PLANOSZ_WORKER_STACK_SIZE
	int "Executor worker thread stack size"
	default 3072

config PLANOSZ_WORKER_PRIORITY
	int "Executor worker preemptible thread priority"
	default 7

config PLANOSZ_SHELL
	bool "'planosz' shell commands (plans, admit, run, load, skills)"
	default y
	depends on SHELL

# Pasting IR upload chunks (192 base64 chars per line) needs a bigger command buffer, and the
# shell thread runs the executor's coordinator loop.
configdefault SHELL_CMD_BUFF_SIZE
	default 512 if PLANOSZ_SHELL

configdefault SHELL_STACK_SIZE
	default 4096 if PLANOSZ_SHELL

endif # PLANOSZ
```
